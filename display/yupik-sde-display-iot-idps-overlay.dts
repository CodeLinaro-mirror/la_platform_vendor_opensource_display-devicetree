// SPDX-License-Identifier: BSD-3-Clause
/*
 * Copyright (c) Qualcomm Technologies, Inc. and/or its subsidiaries.
 */

/dts-v1/;
/plugin/;

#include "yupikp-sde-display-idps.dtsi"

/ {
	model = "Qualcomm Technologies, Inc. YUPIK-IOT IDPS + AMOLED";
	compatible = "qcom,yupikp-iot-idp", "qcom,yupikp-iot", "qcom,idp";
	qcom,msm-id = <497 0x10000>;
	qcom,board-id = <34 2>;
	qcom,pmic-id = <0x0 0x0 0x0 0x3c>;
	qcom,pmic-id-size = <4>;
};
