// SPDX-License-Identifier: BSD-3-Clause
/*
 * Copyright (c) Qualcomm Technologies, Inc. and/or its subsidiaries.
 */

/dts-v1/;
/plugin/;

#include "pebble-sde-display-cdp.dtsi"

/ {
	model = "Qualcomm Technologies, Inc. Pebble CDP";
	compatible = "qcom,pebble-cdp", "qcom,cdp", "qcom,pebble";
	qcom,msm-id = <735 0x10000>;
	qcom,board-id = <0x30001 0x0>, <0x40001 0x0>, <0x10001 0x0>, <0x20001 0x0>, <0x10101 0x0>;
};
