// SPDX-License-Identifier: BSD-3-Clause
/*
 * Copyright (c) Qualcomm Technologies, Inc. and/or its subsidiaries.
 */

#include "shikra-sde-display-common.dtsi"

&sde_dsi {
	clocks = <&clock_cpucc 0>,
		<&clock_cpucc 1>;

	clock-names = "pll_byte_clk0", "pll_dsi_clk0";
};

&dsi_dlc0697_fhd_60_video {
	qcom,mdss-dsi-bl-pmic-control-type = "bl_ctrl_dcs";
	qcom,mdss-dsi-bl-min-level = <10>;
	qcom,mdss-dsi-bl-max-level = <4095>;
	qcom,mdss-brightness-max-level = <8191>;
	qcom,mdss-dsi-bl-inverted-dbv;
	qcom,platform-te-gpio = <&tlmm 86 0>;
	qcom,platform-bklight-en-gpio = <&tlmm 91 0>;
	qcom,platform-en-gpio = <&tlmm 151 0>;
};

&mdss_mdp {
	connectors = <&sde_dsi &smmu_sde_unsec>;
};

&sde_dsi {
		qcom,dsi-default-panel = <&dsi_dlc0697_fhd_60_video>;
};
