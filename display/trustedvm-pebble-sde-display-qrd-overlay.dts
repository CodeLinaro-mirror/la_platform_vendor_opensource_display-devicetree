// SPDX-License-Identifier: BSD-3-Clause
/*Copyright (c) Qualcomm Technologies, Inc. and/or its subsidiaries.
 */

/dts-v1/;
/plugin/;

#include "trustedvm-pebble-sde.dtsi"
#include "trustedvm-pebble-sde-display-qrd.dtsi"

/ {
	model = "Qualcomm Technologies, Inc. Pebble SVM QRD";
	compatible = "qcom,pebble-qrd", "qcom,pebble", "qcom,qrd";
	qcom,board-id = <0x1000b 0>;
};

