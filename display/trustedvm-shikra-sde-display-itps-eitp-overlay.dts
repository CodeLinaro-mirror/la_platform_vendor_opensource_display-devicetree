// SPDX-License-Identifier: BSD-3-Clause
/*
 * Copyright (c) Qualcomm Technologies, Inc. and/or its subsidiaries.
 */

/dts-v1/;
/plugin/;

#include "trustedvm-shikra-sde.dtsi"
#include "trustedvm-shikra-sde-display.dtsi"

/ {
	model = "Qualcomm Technologies, Inc. Shikra SVM EITP/ITP/ITPS";
	compatible = "qcom,shikra-eitp", "qcom,shikra", "qcom,shikrap-eitp",
			"qcom,shikra-itp", "qcom,shikra", "qcom,shikrap-itp",
			"qcom,shikra-itps", "qcom,shikra", "qcom,shikrap-itps",
			"qcom,shikrap", "qcom,eitp", "qcom,itp", "qcom,itps";
	qcom,msm-id = <758 0x10000>, <756 0x10000>;
	qcom,board-id = <0x10033 0x2>, <0x20033 0x2>, <0x30033 0x2>,
			<0x30033 0x0>, <0x20033 0x0>, <0x10033 0x0>,
			<0x40033 0x0>, <0x50033 0x0>, <0x60033 0x0>,
			<0x20033 0x1>, <0x10033 0x1>, <0x30033 0x1>,
			<0x40033 0x1>, <0x50033 0x1>;
};
