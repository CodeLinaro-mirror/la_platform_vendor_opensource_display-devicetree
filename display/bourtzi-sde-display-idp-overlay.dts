// SPDX-License-Identifier: BSD-3-Clause
/*
 * Copyright (c) Qualcomm Technologies, Inc. and/or its subsidiaries.
 */

/dts-v1/;
/plugin/;

#include "bourtzi-sde-display-idp.dtsi"

/ {
	model = "Qualcomm Technologies, Inc. Bourtzi MTP";
	compatible = "qcom,bourtzi-mtp", "qcom,mtp", "qcom,bourtzi";
	qcom,msm-id = <776 0x10000>;
	qcom,board-id = <0x10008 0x0>;
};
