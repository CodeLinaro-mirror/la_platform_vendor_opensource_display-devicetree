//SPDX-License-Identifier: BSD-3-Clause
/*
 * Copyright (c) 2025 Qualcomm Innovation Center, Inc. All rights reserved
 */

/dts-v1/;
/plugin/;

#include "qcs410-sde-display-opk.dtsi"

/ {
	model = "Qualcomm Technologies, Inc. QCS410 Openkit Overlay";
	compatible = "qcom,qcs410-opk", "qcom,qcs410", "qcom,opk";
	qcom,msm-id = <406 0x0>;
	qcom,board-id = <32 3>;
};
