// SPDX-License-Identifier: BSD-3-Clause
/*
 * Copyright (c) Qualcomm Technologies, Inc. and/or its subsidiaries.
 */

#include "pebble-sde-display-common.dtsi"

&mdss_mdp {
	connectors = <&sde_dsi &smmu_sde_unsec>;
};
