// SPDX-License-Identifier: BSD-3-Clause
/*
 * Copyright (c) Qualcomm Technologies, Inc. and/or its subsidiaries.
 */

/dts-v1/;
/plugin/;

#include "coast-sde.dtsi"

/ {
	qcom,msm-id = <761 0x10000>, <797 0x10000>;
	qcom,board-id = <0 0>;
};
