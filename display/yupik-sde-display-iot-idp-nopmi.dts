/dts-v1/;
/plugin/;

#include "yupik-sde-display-idp-nopmi.dtsi"

/ {
	model = "Qualcomm Technologies, Inc. YUPIK-IOT IDP";
	compatible = "qcom,yupik-iot-idp", "qcom,yupik-iot", "qcom,idp";
	qcom,msm-id = <497 0x10000>, <575 0x10000>, <576 0x10000>;
	qcom,board-id = <34 0>;
	qcom,pmic-id = <0x0 0x0 0x0 0x3c>;
	qcom,pmic-id-size = <4>;
};
