// SPDX-License-Identifier: BSD-3-Clause
/*
 * Copyright (c) Qualcomm Technologies, Inc. and/or its subsidiaries.
 */

/dts-v1/;
/plugin/;

#include "shikra-sde-display-cqs-cqm-evk-low-ram.dtsi"

/ {
	model = "Qualcomm Technologies, Inc. Shikra EVK (CQS/CQM)";
	compatible = "qcom,shikra-cqs", "qcom,shikra-cqm", "qcom,shikra-evk", "qcom,evk";
	qcom,msm-id = <756 0x10000>, <758 0x10000>;
	qcom,board-id = <0x30033 0x302>, <0x20033 0x302>, <0x10033 0x302>,
			<0x30033 0x402>, <0x20033 0x402>, <0x10033 0x402>,
			<0x20033 0x300>, <0x20033 0x400>,
			<0x30033 0x300>, <0x30033 0x400>,
			<0x10033 0x300>, <0x10033 0x400>,
			<0x40033 0x301>, <0x40033 0x401>,
			<0x30033 0x301>, <0x30033 0x401>,
			<0x20033 0x301>, <0x20033 0x401>,
			<0x10033 0x301>, <0x10033 0x401>;
};
