// SPDX-License-Identifier: BSD-3-Clause
/*
 * Copyright (c) Qualcomm Technologies, Inc. and/or its subsidiaries.
 */

/dts-v1/;
/plugin/;

#include "shikra-sde-display-itps-slt.dtsi"

/ {
	model = "Qualcomm Technologies, Inc. Shikra ITPS + SLT";
	compatible = "qcom,shikra-cqs", "qcom,shikra-cqm", "qcom,shikra-evk", "qcom,evk";
	qcom,msm-id = <756 0x10000>;
	qcom,board-id = <0x20033 1>, <0x40033 1>;
};
