/dts-v1/;
/plugin/;

#include "yupik-sde.dtsi"

/ {

	model = "Qualcomm Technologies, Inc. Yupik";
	compatible = "qcom,yupik", "qcom,yupik-iot", "qcom,yupik-iot-idp", "qcom,yupik-iot-qrd", "qcom,yupikp",
			"qcom,yupikp-iot", "qcom,yupikp-iot-idp", "qcom,yupikp-iot-qrd";
	qcom,msm-id = <475 0x10000>, <497 0x10000>, <575 0x10000>, <576 0x10000>, <499 0x10000>, <498 0x10000>;
	qcom,board-id = <0 0>;

};
