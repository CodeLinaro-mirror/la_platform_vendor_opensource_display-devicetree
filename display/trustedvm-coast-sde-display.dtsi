// SPDX-License-Identifier: BSD-3-Clause
/*
 * Copyright (c) Qualcomm Technologies, Inc. and/or its subsidiaries.
 */

#include "coast-sde-display-common.dtsi"
#include <dt-bindings/interrupt-controller/arm-gic.h>
#include <dt-bindings/soc/qcom,ipcc.h>
#include <dt-bindings/mailbox/qcom-ipcc.h>

&mdss_mdp {
	connectors = <&sde_dsi &sde_dsi1 &smmu_sde_unsec>;
};
