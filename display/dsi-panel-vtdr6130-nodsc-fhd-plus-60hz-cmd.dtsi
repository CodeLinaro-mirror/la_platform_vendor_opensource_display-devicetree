// SPDX-License-Identifier: BSD-3-Clause
/*
 * Copyright (c) Qualcomm Technologies, Inc. and/or its subsidiaries.
 */

&mdss_mdp {
	dsi_vtdr6130_amoled_nodsc_60hz_cmd: qcom,mdss_dsi_vtdr6130_nodsc_fhd_plus_60hz_cmd {
		qcom,mdss-dsi-panel-name =
			"vtdr6130 amoled cmd mode 60hz dsi visionox panel without dsc";
		qcom,mdss-dsi-panel-type = "dsi_cmd_mode";
		qcom,mdss-dsi-panel-physical-type = "oled";
		qcom,mdss-dsi-virtual-channel-id = <0>;
		qcom,mdss-dsi-stream = <0>;
		qcom,mdss-dsi-bpp = <24>;
		qcom,mdss-dsi-color-order = "rgb_swap_rgb";
		qcom,mdss-dsi-underflow-color = <0xff>;
		qcom,mdss-dsi-border-color = <0>;

		qcom,dsi-ctrl-num = <0>;
		qcom,dsi-phy-num = <0>;

		qcom,dsi-sec-ctrl-num = <1>;
		qcom,dsi-sec-phy-num = <1>;

		qcom,mdss-dsi-traffic-mode = "non_burst_sync_event";
		qcom,mdss-dsi-lane-map = "lane_map_0123";
		qcom,mdss-dsi-bllp-eof-power-mode;
		qcom,mdss-dsi-bllp-power-mode;
		qcom,mdss-dsi-lane-0-state;
		qcom,mdss-dsi-lane-1-state;
		qcom,mdss-dsi-lane-2-state;
		qcom,mdss-dsi-lane-3-state;
		qcom,mdss-dsi-dma-trigger = "trigger_sw";
		qcom,mdss-dsi-mdp-trigger = "none";
		qcom,mdss-dsi-reset-sequence = <1 10>, <0 10>, <1 10>;

		qcom,mdss-dsi-panel-hdr-color-primaries = <14500 15500 32000
				17000 15500 30000 8000 3000>;
		qcom,mdss-dsi-panel-peak-brightness = <4200000>;
		qcom,mdss-dsi-panel-blackness-level = <3230>;
		qcom,mdss-pan-physical-width-dimension = <72>;
		qcom,mdss-pan-physical-height-dimension = <159>;

		qcom,mdss-dsi-te-pin-select = <1>;
		qcom,mdss-dsi-wr-mem-start = <0x2c>;
		qcom,mdss-dsi-wr-mem-continue = <0x3c>;
		qcom,mdss-dsi-te-dcs-command = <1>;
		qcom,mdss-dsi-te-check-enable;
		qcom,mdss-dsi-te-using-te-pin;

		qcom_mdss_dsi_display_timings_279: qcom,mdss-dsi-display-timings {
			timing_0_280: timing@0 {
				cell-index = <0>;
				qcom,mdss-dsi-panel-framerate = <60>;
				qcom,mdss-dsi-panel-width = <1080>;
				qcom,mdss-dsi-panel-height = <2400>;
				qcom,mdss-dsi-h-front-porch = <20>;
				qcom,mdss-dsi-h-back-porch = <20>;
				qcom,mdss-dsi-h-pulse-width = <2>;
				qcom,mdss-dsi-h-sync-skew = <0>;
				qcom,mdss-dsi-v-back-porch = <18>;
				qcom,mdss-dsi-v-front-porch = <20>;
				qcom,mdss-dsi-v-pulse-width = <2>;
				qcom,mdss-dsi-h-left-border = <0>;
				qcom,mdss-dsi-h-right-border = <0>;
				qcom,mdss-dsi-v-top-border = <0>;
				qcom,mdss-dsi-v-bottom-border = <0>;
				qcom,mdss-dsi-panel-jitter = <0x4 0x1>;

				qcom,mdss-dsi-on-command = [
					/* CMODE */
					39 01 00 00 00 00 02 03 00

					/* TE control */
					39 01 00 00 00 00 02 35 00

					/* WRCTRLD */
					39 01 00 00 00 00 02 53 20

					/* WRDISBV */
					39 01 00 00 00 00 03 51 07 ff

					/* DMRON */
					39 01 00 00 00 00 02 59 09

					/* FRMOSEL */
					39 01 00 00 00 00 02 6c 01

					/* AODMOSEL */
					39 01 00 00 00 00 02 6d 00

					/* RDMCTRL */
					39 01 00 00 00 00 02 6f 02

					/* Enable CMD2, page 0 */
					39 01 00 00 00 00 03 f0 aa 10

					/* B1 */
					39 01 00 00 00 00 16 b1 01 38 00 14 00
						1c 00 01 b0 00 14 00 14 01 01 66 00
						14 05 cc 00

					/* BD */
					39 01 00 00 00 00 02 bd 01
					/* C3 */
					39 01 00 00 00 00 02 c3 44

					/* Enable CMD2, page 3 */
					39 01 00 00 00 00 03 f0 aa 13

					/* CE */
					39 01 00 00 00 00 18 ce 09 11 09 11 08
						c1 07 fa 05 a4 00 3c 00 34 00 24 00
						0c 00 0c 04 00 35

					/* Enable CMD2, page 4 */
					39 01 00 00 00 00 03 f0 aa 14

					/* B2 */
					39 01 00 00 00 00 03 b2 03 33

					/* B4 */
					39 01 00 00 00 00 0d b4 00 33 00 00 00
					   3e 00 00 00 3e 00 00

					/* B5 */
					39 01 00 00 00 00 0a b5 00 09 09 09 09
					   09 09 06 01

					/* B9 */
					39 01 00 00 00 00 07 b9 00 00 08 09 09
					   09

					/* BC */
					39 01 00 00 00 00 0d bc 10 00 00 06 11
					   09 3b 09 47 09 47 00

					/* BE */
					39 01 00 00 00 00 0d be 10 10 00 08 22
					   09 19 09 25 09 25 00

					/* Vendor page 0x80 */
					39 01 00 00 00 00 03 ff 5a 80
					39 01 00 00 00 00 02 65 14
					39 01 00 00 00 00 04 fa 08 08 08

					/* Vendor page 0x81 */
					39 01 00 00 00 00 03 ff 5a 81
					39 01 00 00 00 00 02 65 05
					39 01 00 00 00 00 02 f3 0f

					/* Disable CMD2 */
					39 01 00 00 00 00 03 f0 aa 00

					/* Vendor page 0x00 */
					39 01 00 00 00 00 03 ff 5a 00
					39 01 00 00 00 00 02 65 01
					39 01 00 00 00 00 02 f4 9a

					/* Restore vendor page 0x00 */
					39 01 00 00 00 00 03 ff 5a 00

					/* Sleep Out, delay 120 ms */
					05 01 00 00 78 00 01 11

					/* Display On, delay 120 ms */
					05 01 00 00 78 00 01 29
				];

				qcom,mdss-dsi-off-command = [
					05 01 00 00 14 00 02 28 00
					05 01 00 00 78 00 02 10 00];

				qcom,mdss-dsi-on-command-state = "dsi_lp_mode";
				qcom,mdss-dsi-off-command-state = "dsi_hs_mode";
				qcom,mdss-dsi-timing-switch-command-state =
					"dsi_lp_mode";
				qcom,mdss-dsi-h-sync-pulse = <0>;
			};
		};
	};
};
