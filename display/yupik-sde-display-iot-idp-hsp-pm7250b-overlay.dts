// SPDX-License-Identifier: BSD-3-Clause
/*
 * Copyright (c) Qualcomm Technologies, Inc. and/or its subsidiaries.
 */

/dts-v1/;
/plugin/;

#include "yupik-sde-display-idp-pm7250b.dtsi"

/ {

	model = "Qualcomm Technologies, Inc. Yupik IOT HSP + PM7250B";
        compatible = "qcom,yupik-iot-idp", "qcom,yupik-iot", "qcom,idp";
        qcom,msm-id = <497 0x10000>;
        qcom,board-id = <34 1>;
	qcom,pmic-id = <0x0 0x0 0x0 0x0 0x0 0x0 0x0 0x0 0x2e>;
	qcom,pmic-id-size = <9>;

};
