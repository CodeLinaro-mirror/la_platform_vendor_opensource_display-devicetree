// SPDX-License-Identifier: BSD-3-Clause
/*
 * Copyright (c) Qualcomm Technologies, Inc. and/or its subsidiaries.
 */

/dts-v1/;
/plugin/;

#include "trustedvm-coast-sde.dtsi"
#include "trustedvm-coast-sde-display-qrd.dtsi"

/ {
	model = "Qualcomm Technologies, Inc. Coast QRD + LP5 + WCN7750 + UFS4.1";
	compatible = "qcom,coast-qrd", "qcom,coastp-qrd", "qcom,qrd", "qcom,coast", "qcom,coastp";
	qcom,msm-id = <761 0x10000>, <797 0x10000>;
	qcom,board-id = <0x1000b 0x0>, <0x2000b 0x0>;
};
