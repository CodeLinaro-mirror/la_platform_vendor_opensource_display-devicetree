// SPDX-License-Identifier: BSD-3-Clause
/*
 * Copyright (c) Qualcomm Technologies, Inc. and/or its subsidiaries.
 */

&non_devices_common {
	required-subnodes-display = <
		&clock_cpucc
		&config
		&config_63
		&config_65
		&config_67
		&config_69
		&config_71
		&display_panel_avdd
		&display_panel_avdd_default
		&display_panel_vdd
		&display_panel_vdd_default
		&display_panel_vddio
		&display_panel_vddio_default
		&dsi_ft8726_fhd_plus_120_video
		&dsi_ft8726_fhd_plus_60_video
		&dsi_ft8726_fhd_plus_90_video
		&dsi_panel_pwr_supply_amoled
		&dsi_panel_pwr_supply_lcd
		&dsi_panel_pwr_supply_lcd_labibb
		&dsi_panel_pwr_supply_sim
		&dsi_pll_codes_data
		&dsi_sim_cmd
		&dsi_sim_dsc_10b_cmd
		&dsi_sim_dsc_375_cmd
		&dsi_sim_vid
		&dsi_vtdr6130_amoled_120hz_cmd
		&dsi_vtdr6130_amoled_120hz_video
		&dsi_vtdr6130_amoled_60hz_cmd
		&dsi_vtdr6130_amoled_60hz_video
		&dsi_vtdr6130_amoled_90hz_cmd
		&dsi_vtdr6130_amoled_90hz_video
		&dsi_vtdr6130_amoled_cmd
		&dsi_vtdr6130_amoled_nodsc_60hz_cmd
		&dsi_vtdr6130_amoled_qsync_144hz_cmd
		&dsi_vtdr6130_amoled_qsync_144hz_video
		&dsi_vtdr6130_amoled_video
		&lcd_backlight_ctrl
		&lcd_backlight_ctrl_1
		&lcd_backlight_ctrl_2
		&lcd_backlight_ctrl_3
		&lcd_backlight_en_default
		&lcd_backlight_pwm_default
		&mdss_dsi0
		&mdss_dsi_phy0
		&mdss_mdp
		&mux
		&mux_62
		&mux_64
		&mux_66
		&mux_68
		&mux_70
		&pmx_sde
		&pmx_sde_te
		&qcom_ctrl_supply_entries
		&qcom_ctrl_supply_entry_0
		&qcom_mdss_dsi_display_timings
		&qcom_mdss_dsi_display_timings_1
		&qcom_mdss_dsi_display_timings_15
		&qcom_mdss_dsi_display_timings_197
		&qcom_mdss_dsi_display_timings_20
		&qcom_mdss_dsi_display_timings_217
		&qcom_mdss_dsi_display_timings_22
		&qcom_mdss_dsi_display_timings_230
		&qcom_mdss_dsi_display_timings_26
		&qcom_mdss_dsi_display_timings_269
		&qcom_mdss_dsi_display_timings_273
		&qcom_mdss_dsi_display_timings_277
		&qcom_mdss_dsi_display_timings_279
		&qcom_mdss_dsi_display_timings_28
		&qcom_mdss_dsi_display_timings_281
		&qcom_mdss_dsi_display_timings_286
		&qcom_mdss_dsi_display_timings_288
		&qcom_mdss_dsi_display_timings_290
		&qcom_mdss_dsi_display_timings_31
		&qcom_mdss_dsi_display_timings_33
		&qcom_mdss_dsi_display_timings_35
		&qcom_mdss_dsi_display_timings_37
		&qcom_mdss_dsi_display_timings_39
		&qcom_mdss_dsi_display_timings_41
		&qcom_mdss_dsi_display_timings_43
		&qcom_mdss_dsi_display_timings_45
		&qcom_mdss_dsi_display_timings_47
		&qcom_mdss_dsi_display_timings_49
		&qcom_mdss_dsi_display_timings_5
		&qcom_mdss_dsi_display_timings_51
		&qcom_mdss_dsi_display_timings_53
		&qcom_mdss_dsi_display_timings_56
		&qcom_mdss_dsi_display_timings_58
		&qcom_mdss_dsi_display_timings_60
		&qcom_mdss_dsi_display_timings_87
		&qcom_mdss_dsi_display_timings_93
		&qcom_mdss_dsi_display_timings_95
		&qcom_mdss_dsi_display_timings_98
		&qcom_panel_supply_entry_0
		&qcom_panel_supply_entry_0_12
		&qcom_panel_supply_entry_0_8
		&qcom_panel_supply_entry_0_9
		&qcom_panel_supply_entry_1
		&qcom_panel_supply_entry_1_10
		&qcom_panel_supply_entry_1_13
		&qcom_panel_supply_entry_2
		&qcom_panel_supply_entry_2_11
		&qcom_panel_supply_entry_2_14
		&qcom_panel_supply_entry_3
		&qcom_phy_supply_entries
		&qcom_phy_supply_entry_0
		&qcom_sde_dspp_blocks
		&qcom_sde_sspp_vig_blocks
		&sde_dsi
		&sde_dsi_active
		&sde_dsi_suspend
		&sde_te_active
		&sde_te_suspend
		&smmu_sde_iommu_region_partition
		&smmu_sde_unsec
		&timing_0
		&timing_0_16
		&timing_0_198
		&timing_0_2
		&timing_0_21
		&timing_0_218
		&timing_0_23
		&timing_0_231
		&timing_0_27
		&timing_0_270
		&timing_0_274
		&timing_0_278
		&timing_0_280
		&timing_0_282
		&timing_0_287
		&timing_0_289
		&timing_0_29
		&timing_0_291
		&timing_0_32
		&timing_0_34
		&timing_0_36
		&timing_0_38
		&timing_0_40
		&timing_0_42
		&timing_0_44
		&timing_0_46
		&timing_0_48
		&timing_0_50
		&timing_0_52
		&timing_0_54
		&timing_0_57
		&timing_0_59
		&timing_0_61
		&timing_0_94
		&timing_0_96
		&timing_1
		&timing_10_109
		&timing_10_208
		&timing_10_228
		&timing_11_110
		&timing_11_209
		&timing_11_229
		&timing_12_210
		&timing_13_211
		&timing_14_212
		&timing_15_213
		&timing_16_214
		&timing_17_215
		&timing_18_216
		&timing_19_217
		&timing_1_100
		&timing_1_17
		&timing_1_199
		&timing_1_219
		&timing_1_232
		&timing_1_24
		&timing_1_275
		&timing_1_283
		&timing_1_3
		&timing_1_30
		&timing_1_55
		&timing_2
		&timing_20_299
		&timing_2_18
		&timing_2_200
		&timing_2_220
		&timing_2_25
		&timing_2_276
		&timing_2_284
		&timing_2_4
		&timing_2_6
		&timing_2_90
		&timing_3
		&timing_3_19
		&timing_3_201
		&timing_3_221
		&timing_3_285
		&timing_3_7
		&timing_3_91
		&timing_4_202
		&timing_4_222
		&timing_4_92
		&timing_5_104
		&timing_5_203
		&timing_5_223
		&timing_6_105
		&timing_6_204
		&timing_6_224
		&timing_7
		&timing_7_106
		&timing_7_205
		&timing_7_225
		&timing_8
		&timing_8_107
		&timing_8_206
		&timing_8_226
		&timing_9_108
		&timing_9_207
		&timing_9_227
		&vcm_0
	>;
};

