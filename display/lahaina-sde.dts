// SPDX-License-Identifier: BSD-3-Clause
/*
 * Copyright (c) Qualcomm Technologies, Inc. and/or its subsidiaries.
 */

/dts-v1/;
/plugin/;

#include "lahaina-sde.dtsi"

/ {

	model = "Qualcomm Technologies, Inc. Lahaina MTP v2";
	compatible = "qcom,lahaina", "qcom,lahaina-cdp", "qcom,cdp", "qcom,lahaina-mtp", "qcom,mtp";
	qcom,msm-id = <415 0x20000>, <456 0x20000>, <501 0x20000>, <415 0x10000>;
	qcom,board-id =  <0 0>, <0x20008 0>, <0x20108 0>, <0x1000B 0>, <0x10008 0>, <0x20201 0>;
};
