// SPDX-License-Identifier: BSD-3-Clause
/*
 * Copyright (c) Qualcomm Technologies, Inc. and/or its subsidiaries.
 */

/dts-v1/;
/plugin/;

#include "lahaina-sde-display-mtp.dtsi"

/ {
	model = "Qualcomm Technologies, Inc. Lahaina MTP v2";
	compatible = "qcom,lahaina-mtp", "qcom,lahaina", "lahainap", "qcom,mtp";
	qcom,msm-id = <415 0x20000>, <456 0x20000>, <501 0x20000>;
	qcom,board-id = <0x20008 0>, <0x10008 0>;
};
