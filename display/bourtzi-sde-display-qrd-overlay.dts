// SPDX-License-Identifier: BSD-3-Clause
/*
 * Copyright (c) Qualcomm Technologies, Inc. and/or its subsidiaries.
 */

/dts-v1/;
/plugin/;

#include "bourtzi-sde-display-qrd.dtsi"

/ {
	model = "Qualcomm Technologies, Inc. Bourtzi QRD";
	compatible = "qcom,bourtzi-qrd", "qcom,qrd", "qcom,bourtzi";
	qcom,msm-id = <776 0x10000>;
	qcom,board-id = <0x2000b 0x0>, <0x1000b 0x0>;
};
