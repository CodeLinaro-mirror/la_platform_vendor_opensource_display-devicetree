/dts-v1/;
/plugin/;

#include "yupikP-sde-display-idps.dtsi"

/ {
	model = "Qualcomm Technologies, Inc. YUPIKP-IOT IDPS + AMOLED";
	compatible = "qcom,yupikp-iot-idp", "qcom,yupikp-iot", "qcom,idp";
	qcom,msm-id = <498 0x10000>;
	qcom,board-id = <34 2>;
	qcom,pmic-id = <0x0 0x0 0x0 0x3c>;
	qcom,pmic-id-size = <4>;
};
