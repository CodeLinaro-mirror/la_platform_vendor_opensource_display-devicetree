// SPDX-License-Identifier: BSD-3-Clause
/*
 * Copyright (c) Qualcomm Technologies, Inc. and/or its subsidiaries.
 */

/dts-v1/;
/plugin/;

#include "shikra-sde-display-iqs.dtsi"

/ {
	model = "Qualcomm Technologies, Inc. Shikra IQS";
	compatible = "qcom,shikra-iqs";
	qcom,msm-id = <759 0x10000>;
	qcom,board-id = <0x40033 0>, <0x60033 0>,
			<0x40033 1>, <0x50033 1>,
			<0x30033 2>;
};
