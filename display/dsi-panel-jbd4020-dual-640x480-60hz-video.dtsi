// SPDX-License-Identifier: BSD-3-Clause
/*
 * Copyright (c) Qualcomm Technologies, Inc. and/or its subsidiaries.
 */

&mdss_mdp {
	dsi_jbd4020_dual_640x480_60hz_video: qcom,mdss_dsi_jbd4020_dual_640x480_60hz_video {
		qcom,mdss-dsi-panel-name =
			"JBD uLED video mode panel without DSC";
		qcom,mdss-dsi-panel-type = "dsi_video_mode";
		qcom,mdss-dsi-panel-physical-type = "oled";
		qcom,mdss-dsi-virtual-channel-id = <0>;
		qcom,mdss-dsi-stream = <0>;
		qcom,mdss-dsi-bpp = <24>;
		qcom,mdss-dsi-border-color = <0>;
		qcom,dsi-ctrl-num = <0 1>;
		qcom,dsi-phy-num = <0 1>;
		qcom,mdss-dsi-traffic-mode = "non_burst_sync_event";
		qcom,mdss-dsi-bllp-eof-power-mode;
		qcom,mdss-dsi-bllp-power-mode;
		qcom,mdss-dsi-lane-0-state;
		qcom,mdss-dsi-dma-trigger = "trigger_sw";
		qcom,mdss-dsi-mdp-trigger = "none";
		qcom,mdss-dsi-reset-sequence = <1 10>, <0 10>, <1 20>;

		qcom,mdss-panel-i2c-on-command = [
			/* SRAM initialization */
			/* Switch off PWM_CLK */
			59 00 08 03 03 03 00 10 00 00 00
			5A 00 08 03 03 03 00 10 00 00 00
			5B 00 08 03 03 03 00 10 00 00 00
			/* Panel initialization */
			59 00 08 03 03 01 44 00 00 00 40
			5A 00 08 03 03 01 44 00 00 00 40
			5B 00 08 03 03 01 44 00 00 00 40
			/* Set max resolution to cover all pixels including dummy ones */
			59 00 08 03 00 01 C8 FF F1 29 00
			5A 00 08 03 00 01 C8 FF F1 29 00
			5B 00 08 03 00 01 C8 FF F1 29 00
			/* Background gray level set to 0 */
			59 00 08 03 00 01 B8 00 00 00 00
			5A 00 08 03 00 01 B8 00 00 00 00
			5B 00 08 03 00 01 B8 00 00 00 00
			/* Mute enable */
			59 00 08 03 00 01 C4 01 00 00 00
			5A 00 08 03 00 01 C4 01 00 00 00
			5B 00 08 03 00 01 C4 01 00 00 00
			/* Display background color mode */
			59 00 08 03 00 01 80 1B D0 03 20
			5A 00 08 03 00 01 80 1B D0 03 20
			5B 00 08 03 00 01 80 1B D0 03 20
			/* Display port enable */
			59 00 08 03 03 01 00 11 00 00 80
			5A 00 08 03 03 01 00 11 00 00 80
			5B 00 08 03 03 01 00 11 00 00 80
			/* Trigger refresh */
			59 00 08 03 04 00 08 01 00 00 00
			5A 00 08 03 04 00 08 01 00 00 00
			/* 30 ms wait */
			5B 1E 08 03 04 00 08 01 00 00 00
			/* XDP reset */
			59 00 08 01 00 00 3C 3F 1F 02 20
			5A 00 08 01 00 00 3C 3F 1F 02 20
			5B 00 08 01 00 00 3C 3F 1F 02 20
			/* XDP reset release */
			59 00 08 01 00 00 3C 3F 00 02 20
			5A 00 08 01 00 00 3C 3F 00 02 20
			5B 00 08 01 00 00 3C 3F 00 02 20

			/* Clear MIPI interruptions */
			59 00 08 02 00 67 20 FF FF FF FF
			5A 00 08 02 00 67 20 FF FF FF FF
			5B 00 08 02 00 67 20 FF FF FF FF

			59 00 08 02 00 67 24 FF FF FF FF
			5A 00 08 02 00 67 24 FF FF FF FF
			5B 00 08 02 00 67 24 FF FF FF FF

			59 00 08 02 00 67 28 FF FF FF FF
			5A 00 08 02 00 67 28 FF FF FF FF
			5B 00 08 02 00 67 28 FF FF FF FF
			/* Error count reset */
			59 00 08 02 00 67 40 FF FF FF FF
			5A 00 08 02 00 67 40 FF FF FF FF
			5B 00 08 02 00 67 40 FF FF FF FF

			/* Init code */
			/* MIPI PCS configuration */
			59 00 08 02 00 72 28 FF 33 0C 00
			5A 00 08 02 00 72 28 FF 33 0C 00
			5B 00 08 02 00 72 28 FF 33 0C 00

			59 00 08 02 00 70 10 04 00 00 00
			5A 00 08 02 00 70 10 04 00 00 00
			5B 00 08 02 00 70 10 04 00 00 00

			59 00 08 02 00 7D FC FF FF FF FF
			5A 00 08 02 00 7D FC FF FF FF FF
			5B 00 08 02 00 7D FC FF FF FF FF

			59 00 08 02 00 72 C0 01 00 00 00
			5A 00 08 02 00 72 C0 01 00 00 00
			5B 00 08 02 00 72 C0 01 00 00 00

			59 00 08 02 00 72 C0 00 00 00 00
			5A 00 08 02 00 72 C0 00 00 00 00
			5B 00 08 02 00 72 C0 00 00 00 00

			/* MIPI CTRL configuration */
			59 00 08 02 00 60 0c 01 00 00 00
			5A 00 08 02 00 60 0c 01 00 00 00
			5B 00 08 02 00 60 0c 01 00 00 00

			59 00 08 02 00 60 A8 63 22 00 00
			5A 00 08 02 00 60 A8 63 22 00 00
			5B 00 08 02 00 60 A8 63 22 00 00

			59 00 08 02 00 60 14 00 02 00 00
			5A 00 08 02 00 60 14 00 02 00 00
			5B 00 08 02 00 60 14 00 02 00 00

			59 00 08 02 00 62 00 01 00 00 00
			5A 00 08 02 00 62 00 01 00 00 00
			5B 00 08 02 00 62 00 01 00 00 00

			59 00 08 02 00 62 30 00 00 00 00
			5A 00 08 02 00 62 30 00 00 00 00
			5B 00 08 02 00 62 30 00 00 00 00

			59 00 08 02 00 67 00 FF FF 1F 00
			5A 00 08 02 00 67 00 FF FF 1F 00
			5B 00 08 02 00 67 00 FF FF 1F 00

			59 00 08 02 00 67 04 FF FF 3F 00
			5A 00 08 02 00 67 04 FF FF 3F 00
			5B 00 08 02 00 67 04 FF FF 3F 00

			59 00 08 02 00 67 08 FF 1B 18 00
			5A 00 08 02 00 67 08 FF 1B 18 00
			5B 00 08 02 00 67 08 FF 1B 18 00

			59 00 08 02 00 61 60 FF FF 01 00
			5A 00 08 02 00 61 60 FF FF 01 00
			5B 00 08 02 00 61 60 FF FF 01 00

			59 00 08 02 00 67 88 1F 00 00 02
			5A 00 08 02 00 67 88 1F 00 00 02
			5B 00 08 02 00 67 88 1F 00 00 02

			59 00 08 02 00 60 00 02 00 02 00
			5A 00 08 02 00 60 00 02 00 02 00
			5B 00 08 02 00 60 00 02 00 02 00

			59 00 08 01 00 00 90 86 0F 60 00
			5A 00 08 01 00 00 90 86 0F 60 00
			5B 00 08 01 00 00 90 86 0F 60 00

			59 00 08 02 00 60 00 02 00 00 00
			5A 00 08 02 00 60 00 02 00 00 00
			5B 00 08 02 00 60 00 02 00 00 00

			/* Red channel */
			59 00 08 03 04 00 00 03 01 00 00
			/* Green channel */
			5A 00 08 03 04 00 00 03 41 00 00
			/* Blue channel */
			5B 00 08 03 04 00 00 03 81 00 00

			/* Display resolution setting: 480*640 */
			59 00 08 03 00 00 D0 7F 02 DF 01
			5A 00 08 03 00 00 D0 7F 02 DF 01
			5B 00 08 03 00 00 D0 7F 02 DF 01
			/* Set signal interval */
			59 00 08 03 00 00 80 00 01 00 00
			5A 00 08 03 00 00 80 00 01 00 00
			5B 00 08 03 00 00 80 00 01 00 00
			/* Set refresh mode */
			59 00 08 03 03 03 00 00 00 00 00
			5A 00 08 03 03 03 00 00 00 00 00
			5B 00 08 03 03 03 00 00 00 00 00
			/* ?? */
			59 00 08 03 04 10 04 01 00 00 00
			5A 00 08 03 04 10 04 01 00 00 00
			5B 00 08 03 04 10 04 01 00 00 00
			/* Panel refresh rate setting: 60Hz */
			59 00 08 01 00 00 3C 3F 00 44 22
			5A 00 08 01 00 00 3C 3F 00 44 22
			5B 00 08 01 00 00 3C 3F 00 44 22
			/* Switch off AA current source */
			59 00 08 02 00 00 30 03 FF 00 00
			5A 00 08 02 00 00 30 03 FF 00 00
			5B 00 08 02 00 00 30 03 FF 00 00
			/* Driven current adjustment: Pixel Current 1.6uA */
			59 00 08 03 02 AE 90 5A 00 01 00
			5A 00 08 03 02 AE 90 5A 00 01 00
			5B 00 08 03 02 AE 90 5A 00 01 00
			/* Display port enable */
			59 00 08 03 03 01 00 11 00 00 80
			5A 00 08 03 03 01 00 11 00 00 80
			5B 00 08 03 03 01 00 11 00 00 80

			/* Random scan off */
			59 00 08 03 03 03 1C 00 00 00 00
			5A 00 08 03 03 03 1C 00 00 00 00
			5B 00 08 03 03 03 1C 00 00 00 00

			59 00 08 03 03 03 20 00 00 00 00
			5A 00 08 03 03 03 20 00 00 00 00
			5B 00 08 03 03 03 20 00 00 00 00

			59 00 08 03 03 03 24 00 00 00 00
			5A 00 08 03 03 03 24 00 00 00 00
			5B 00 08 03 03 03 24 00 00 00 00

			59 00 08 03 03 03 28 00 00 00 00
			5A 00 08 03 03 03 28 00 00 00 00
			5B 00 08 03 03 03 28 00 00 00 00

			59 00 08 03 03 03 2C 00 00 00 00
			5A 00 08 03 03 03 2C 00 00 00 00
			5B 00 08 03 03 03 2C 00 00 00 00

			/* Display port enable */
			59 00 08 03 03 01 00 11 00 00 80
			5A 00 08 03 03 01 00 11 00 00 80
			5B 00 08 03 03 01 00 11 00 00 80

			/* CRG：DLL output colock */
			59 00 08 01 00 00 AC 05 00 08 00
			5A 00 08 01 00 00 AC 05 00 08 00
			5B 00 08 01 00 00 AC 05 00 08 00

			59 00 08 01 00 00 AC 01 00 08 00
			5A 00 08 01 00 00 AC 01 00 08 00
			5B 00 08 01 00 00 AC 01 00 08 00

			59 00 08 01 00 00 E4 05 00 08 00
			5A 00 08 01 00 00 E4 05 00 08 00
			5B 00 08 01 00 00 E4 05 00 08 00

			59 00 08 01 00 00 E4 01 00 08 00
			5A 00 08 01 00 00 E4 01 00 08 00
			5B 00 08 01 00 00 E4 01 00 08 00

			59 00 08 01 00 00 EC 05 00 08 00
			5A 00 08 01 00 00 EC 05 00 08 00
			5B 00 08 01 00 00 EC 05 00 08 00

			59 00 08 01 00 00 EC 01 00 08 00
			5A 00 08 01 00 00 EC 01 00 08 00
			5B 00 08 01 00 00 EC 01 00 08 00

			59 00 08 01 00 00 AC 03 00 08 00
			5A 00 08 01 00 00 AC 03 00 08 00
			5B 00 08 01 00 00 AC 03 00 08 00

			59 00 08 01 00 00 E4 03 00 08 00
			5A 00 08 01 00 00 E4 03 00 08 00
			5B 00 08 01 00 00 E4 03 00 08 00

			59 00 08 01 00 00 EC 03 00 08 00
			5A 00 08 01 00 00 EC 03 00 08 00
			5B 00 08 01 00 00 EC 03 00 08 00

			59 00 08 01 00 00 02 00 00 00 00
			5A 00 08 01 00 00 02 00 00 00 00
			5B 00 08 01 00 00 02 00 00 00 00

			59 00 08 01 00 00 2C 00 00 00 00
			5A 00 08 01 00 00 2C 00 00 00 00
			5B 00 08 01 00 00 2C 00 00 00 00

			/* CORE CTRL：VDD, MVDD, OSCVDD selection */
			59 00 08 02 00 00 40 09 C2 20 00
			5A 00 08 02 00 00 40 09 C2 20 00
			5B 00 08 02 00 00 40 09 C2 20 00
			/* Switch off MIPI LDO */
			59 00 08 02 00 00 44 8A 44 00 00
			5A 00 08 02 00 00 44 8A 44 00 00
			5B 00 08 02 00 00 44 8A 44 00 00
			/* Switch off OSC LDO */
			59 00 08 02 00 00 48 88 20 00 00
			5A 00 08 02 00 00 48 88 20 00 00
			5B 00 08 02 00 00 48 88 20 00 00

			/* Auto initialization check enable */
			59 00 08 02 00 00 84 02 00 00 00
			5A 00 08 02 00 00 84 02 00 00 00
			5B 00 08 02 00 00 84 02 00 00 00
			/* CMD TOP：DCS & MCS unlock */
			59 00 08 02 00 10 20 5A 5A 5A 5A
			5A 00 08 02 00 10 20 5A 5A 5A 5A
			5B 00 08 02 00 10 20 5A 5A 5A 5A
			/* LTC function Enable */
			59 00 08 03 02 AE 68 01 00 00 00
			5A 00 08 03 02 AE 68 01 00 00 00
			5B 00 08 03 02 AE 68 01 00 00 00

			/* Enable temperature read */
			59 00 08 02 00 30 04 5B 63 03 00
			5A 00 08 02 00 30 04 5B 63 03 00
			5B 00 08 02 00 30 04 5B 63 03 00
			/* Actual Temperatire monitor period */
			59 00 08 02 00 30 04 A5 DB B1 05
			5A 00 08 02 00 30 04 A5 DB B1 05
			5B 00 08 02 00 30 04 A5 DB B1 05

			/* Error interruption configuration */
			59 00 08 02 00 00 04 02 02 00 00
			5A 00 08 02 00 00 04 02 02 00 00
			5B 00 08 02 00 00 04 02 02 00 00
			/* FMC transfer overtime interruption*/
			59 00 08 02 00 50 1C 20 60 00 00
			5A 00 08 02 00 50 1C 20 60 00 00
			5B 00 08 02 00 50 1C 20 60 00 00
			/* BCMG, Error interrupt config for Demura parameters  */
			59 00 08 03 00 00 90 00 00 00 C0
			5A 00 08 03 00 00 90 00 00 00 C0
			5B 00 08 03 00 00 90 00 00 00 C0

			/* Red channel */
			59 00 08 03 04 00 00 03 11 01 00
			/* Green channel */
			5A 00 08 03 04 00 00 03 51 01 00
			/* Blue channel */
			5B 00 08 03 04 00 00 03 91 01 00

			/* ESD interruption configuration */
			59 00 08 02 00 00 04 00 02 00 00
			5A 00 08 02 00 00 04 00 02 00 00
			5B 00 08 02 00 00 04 00 02 00 00
			/* Panel operation error detection: Error flag */
			59 00 08 01 00 10 38 01 00 00 00
			5A 00 08 01 00 10 38 01 00 00 00
			5B 00 08 01 00 10 38 01 00 00 00

			/* FMC (Flash Memory controller) initialization */
			/* Enhance the panel drive capability to flash IO */
			59 00 08 01 00 18 00 00 11 00 00
			5A 00 08 01 00 18 00 00 11 00 00
			5B 00 08 01 00 18 00 00 11 00 00

			59 00 08 01 00 18 04 00 11 00 00
			5A 00 08 01 00 18 04 00 11 00 00
			5B 00 08 01 00 18 04 00 11 00 00

			59 00 08 01 00 18 08 00 11 00 00
			5A 00 08 01 00 18 08 00 11 00 00
			5B 00 08 01 00 18 08 00 11 00 00

			59 00 08 01 00 18 0C 00 11 00 00
			5A 00 08 01 00 18 0C 00 11 00 00
			5B 00 08 01 00 18 0C 00 11 00 00

			59 00 08 01 00 18 10 00 11 00 00
			5A 00 08 01 00 18 10 00 11 00 00
			5B 00 08 01 00 18 10 00 11 00 00

			59 00 08 01 00 18 14 00 11 00 00
			5A 00 08 01 00 18 14 00 11 00 00
			5B 00 08 01 00 18 14 00 11 00 00

			59 00 08 01 00 00 18 00 00 01 00
			5A 00 08 01 00 00 18 00 00 01 00
			5B 00 08 01 00 00 18 00 00 01 00

			59 00 08 01 00 00 18 05 00 00 00
			5A 00 08 01 00 00 18 05 00 00 00
			5B 00 08 01 00 00 18 05 00 00 00

			59 00 08 02 00 50 00 01 00 00 00
			5A 00 08 02 00 50 00 01 00 00 00
			5B 00 08 02 00 50 00 01 00 00 00

			59 00 08 02 00 50 30 30 00 00 00
			5A 00 08 02 00 50 30 30 00 00 00
			5B 00 08 02 00 50 30 30 00 00 00

			/* Flash write enable */
			59 00 08 02 00 50 24 06 00 00 00
			5A 00 08 02 00 50 24 06 00 00 00
			5B 00 08 02 00 50 24 06 00 00 00

			59 00 08 02 00 50 3C 81 00 00 00
			5A 00 08 02 00 50 3C 81 00 00 00
			5B 00 08 02 00 50 3C 81 00 00 00

			/* Gamma load */
			59 00 08 02 00 50 4C 00 AF 02 03
			5A 00 08 02 00 50 4C 00 AF 02 03
			5B 00 08 02 00 50 4C 00 AF 02 03

			59 00 08 02 00 50 2C 00 10 00 00
			5A 00 08 02 00 50 2C 00 10 00 00
			5B 00 08 02 00 50 2C 00 10 00 00

			59 00 08 02 00 50 40 54 11 00 00
			5A 00 08 02 00 50 40 54 11 00 00
			5B 00 08 02 00 50 40 54 11 00 00

			59 00 08 02 00 50 68 01 00 03 00
			5A 00 08 02 00 50 68 01 00 03 00
			/* Delay some time for gamma parameters to load */
			5B 0A 08 02 00 50 68 01 00 03 00

			/* Enable global brightness adjustment & Enable Gamma function */
			59 00 08 03 02 AE 00 80 03 00 00
			5A 00 08 03 02 AE 00 80 03 00 00
			5B 00 08 03 02 AE 00 80 03 00 00

			/* Disable internal Dimming function */
			59 00 08 03 02 AE 04 1E 10 04 01
			5A 00 08 03 02 AE 04 1E 10 04 01
			5B 00 08 03 02 AE 04 1E 10 04 01

			/* Global brightness setting (set 10%), bit 0-12: Brightness control */
			59 00 08 03 02 AE 38 33 03 00 00
			5A 00 08 03 02 AE 38 33 03 00 00
			5B 00 08 03 02 AE 38 33 03 00 00

			/* Demura function off */
			59 00 08 03 00 02 00 18 00 00 00
			5A 00 08 03 00 02 00 18 00 00 00
			5B 00 08 03 00 02 00 18 00 00 00

			/* Dither function off */
			59 00 08 03 02 C6 00 50 C8 1C 00
			5A 00 08 03 02 C6 00 50 C8 1C 00
			5B 00 08 03 02 C6 00 50 C8 1C 00

			59 00 08 03 03 03 1C 00 00 00 00
			5A 00 08 03 03 03 1C 00 00 00 00
			5B 00 08 03 03 03 1C 00 00 00 00

			59 00 08 03 03 03 20 00 00 00 00
			5A 00 08 03 03 03 20 00 00 00 00
			5B 00 08 03 03 03 20 00 00 00 00

			59 00 08 03 03 03 24 00 00 00 00
			5A 00 08 03 03 03 24 00 00 00 00
			5B 00 08 03 03 03 24 00 00 00 00

			59 00 08 03 03 03 28 00 00 00 00
			5A 00 08 03 03 03 28 00 00 00 00
			5B 00 08 03 03 03 28 00 00 00 00

			59 00 08 03 03 03 2C 00 00 00 00
			5A 00 08 03 03 03 2C 00 00 00 00
			5B 00 08 03 03 03 2C 00 00 00 00

			/* State set to CFG_END */
			59 00 08 02 00 00 70 02 00 00 00
			5A 00 08 02 00 00 70 02 00 00 00
			/* Deley 100ms for avee output */
			5B 64 08 02 00 00 70 02 00 00 00

			/* right max77713 avee output -2.0v */
			70 00 02 10 28

			/* left max77713 avee output -2.0v */
			78 00 02 10 28
		];

		qcom,mdss-dsi-display-timings {
			timing@0 {
				cell-index = <0>;
				qcom,mdss-dsi-panel-framerate = <60>;
				qcom,mdss-dsi-panel-width = <640>;
				qcom,mdss-dsi-panel-height = <480>;
				qcom,mdss-dsi-h-front-porch = <20>;
				qcom,mdss-dsi-h-back-porch = <20>;
				qcom,mdss-dsi-h-pulse-width = <4>;
				qcom,mdss-dsi-h-sync-skew = <0>;
				qcom,mdss-dsi-v-back-porch = <2>;
				qcom,mdss-dsi-v-front-porch = <30>;
				qcom,mdss-dsi-v-pulse-width = <2>;
				qcom,mdss-dsi-h-left-border = <0>;
				qcom,mdss-dsi-h-right-border = <0>;
				qcom,mdss-dsi-v-top-border = <0>;
				qcom,mdss-dsi-v-bottom-border = <0>;
				qcom,mdss-dsi-h-sync-pulse = <0>;

				qcom,mdss-dsi-on-command = [
					29 01 00 00 00 00 04 FF 03 03 00
				];
				qcom,mdss-dsi-on-command-state = "dsi_lp_mode";

				qcom,mdss-dsi-off-command = [
					29 01 00 00 00 00 04 FF 03 03 00
				];
				qcom,mdss-dsi-off-command-state = "dsi_hs_mode";
			};
		};
	};
};
