// SPDX-License-Identifier: BSD-3-Clause
/*
 * Copyright (c) Qualcomm Technologies, Inc. and/or its subsidiaries.
 */

#include "bengal-sde-display.dtsi"

&dsi_ili9881p_hd_plus_video {
	qcom,panel-supply-entries = <&dsi_panel_pwr_supply_no_labibb>;
	qcom,mdss-dsi-bl-pmic-control-type = "bl_ctrl_pwm";
	pwms = <&pm6125_pwm 0 0>;
	qcom,bl-pmic-pwm-period-usecs = <100>;
	qcom,mdss-dsi-bl-min-level = <1>;
	qcom,mdss-dsi-bl-max-level = <4095>;
	qcom,platform-reset-gpio = <&tlmm 97 0>;
	qcom,platform-bklight-en-gpio = <&tlmm 40 0>;
};

&mdss_rotator {
	status = "disabled";
};

&sde_dsi {
	qcom,dsi-default-panel = <&dsi_ili9881p_hd_plus_video>;
};
