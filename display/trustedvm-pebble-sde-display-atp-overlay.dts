// SPDX-License-Identifier: BSD-3-Clause
/*
 * Copyright (c) Qualcomm Technologies, Inc. and/or its subsidiaries.
 */
/dts-v1/;
/plugin/;

#include "trustedvm-pebble-sde.dtsi"
#include "trustedvm-pebble-sde-display-atp.dtsi"

/ {
	model = "Qualcomm Technologies, Inc. Pebble SVM ATP";
	compatible = "qcom,pebble-atp", "qcom,pebble", "qcom,atp";
	qcom,board-id = <0x10021 0x0>, <0x20021 0x0>;
};
