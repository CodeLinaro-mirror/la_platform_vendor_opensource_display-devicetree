// SPDX-License-Identifier: BSD-3-Clause
/*
 * Copyright (c) Qualcomm Technologies, Inc. and/or its subsidiaries.
 */

/dts-v1/;
/plugin/;

#include "yupik-sde-display-idp.dtsi"

/ {
	model = "Qualcomm Technologies, Inc. Yupik IDP";
	compatible = "qcom,yupik-idp", "qcom,yupik", "qcom,idp";
	qcom,msm-id = <475 0x10000>;
	qcom,board-id = <34 0>;
	qcom,pmic-id = <0x0 0x0 0x0 0x3c>;
	qcom,pmic-id-size = <4>;
};
