// SPDX-License-Identifier: BSD-3-Clause
/*
 * Copyright (c) Qualcomm Technologies, Inc. and/or its subsidiaries.
 */

/dts-v1/;
/plugin/;

#include "bourtzi-sde-display-mtp-amoled.dtsi"

/ {
	model = "Qualcomm Technologies, Inc. Bourtzi";
	compatible = "qcom,bourtzi-cdp", "qcom,bourtzip-rcm", "qcom,bourtzi-mtp", "qcom,bourtzi-qrd";
	qcom,msm-id = <776 0x10000>, <777 0x10000>;
	qcom,board-id = <0x10001 0x600>, <0x20008 0x0>, <0x10008 0x0>,
			<0x10008 0x600>, <0x2000b 0x0>, <0x1000b 0x0>,
			<0x10015 0x0>, <0x20015 0x0>, <0x40015 0x0>,
			<0x30015 0x600>, <0x10015 0x600>, <0x10021 0x0>;
};
