// SPDX-License-Identifier: BSD-3-Clause
/*
 * Copyright (c) Qualcomm Technologies, Inc. and/or its subsidiaries.
 */

/dts-v1/;
/plugin/;

#include "yupikp-sde-display-rb3-gen2-videocollab.dtsi"

/ {
	model = "Qualcomm Technologies, Inc. Yupik IoT RB3 GEN2";
	compatible = "qcom,yupik-iot-idp", "qcom,yupik-iot", "qcom,idp";
	qcom,msm-id = <498 0x10000>;
	qcom,board-id = <0x010020 1>;
};

