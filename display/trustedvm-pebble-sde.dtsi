// SPDX-License-Identifier: BSD-3-Clause
/*
 * Copyright (c) Qualcomm Technologies, Inc. and/or its subsidiaries.
 */

/dts-v1/;
/plugin/;

#include "pebble-sde-common.dtsi"

&soc {
};

&mdss_dsi0 {
	reg = <0x0 0x09ac0000 0x0 0x1000>,
		<0x0 0x9BB1000 0x0 0x4>,
		<0x0 0x0998f000 0x0 0x300>;
	reg-names = "dsi_ctrl", "disp_cc_base", "mdp_intf_base";
	status = "ok";
};

&mdss_dsi_phy0 {
	reg = <0x0 0x9ac1000 0x0 0xa00>,
		<0x0 0x9ac1500 0x0 0x400>,
		<0x0 0x9ac0200 0x0 0xa0>;
	reg-names = "dsi_phy", "pll_base", "dyn_refresh_base";
	status = "ok";
	qcom,dsi-pll-in-trusted-vm;
};
