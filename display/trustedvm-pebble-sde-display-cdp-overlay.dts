// SPDX-License-Identifier: BSD-3-Clause
/*
 * Copyright (c) Qualcomm Technologies, Inc. and/or its subsidiaries.
 */
/dts-v1/;
/plugin/;

#include "trustedvm-pebble-sde.dtsi"
#include "trustedvm-pebble-sde-display-cdp.dtsi"

/ {
	model = "Qualcomm Technologies, Inc. Pebble SVM CDP";
	compatible = "qcom,pebble-cdp", "qcom,pebble", "qcom,cdp";
	qcom,board-id = <1 0>;
};
