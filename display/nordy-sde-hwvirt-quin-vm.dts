// SPDX-License-Identifier: BSD-3-Clause
/*
 * Copyright (c) Qualcomm Technologies, Inc. and/or its subsidiaries.
 */

/dts-v1/;
/plugin/;

#include "nordy-sde-hwvirt.dtsi"

/ {
	model = "Qualcomm Technologies, Inc. SA8797 Single LA Guest Virtual Machine";
	compatible = "qcom,sa8797p-adp-star", "qcom,sa8797p-adp", "qcom,sa8797p", "qcom,qam", "qcom,quinvm";
	qcom,msm-id = <690 0x10000>, <690 0x20000>, <690 0x10001>;
	qcom,board-id = <0x0 0x1000001>, <0x0 0x2000001>;
};
