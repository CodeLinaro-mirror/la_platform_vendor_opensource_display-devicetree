// SPDX-License-Identifier: BSD-3-Clause
/*
 * Copyright (c) Qualcomm Technologies, Inc. and/or its subsidiaries.
 */

/dts-v1/;
/plugin/;

#include "lahainap-sde-display-mtp.dtsi"

/ {
	model = "Qualcomm Technologies, Inc. LahainaP MTP";
        compatible = "qcom,lahainap-mtp", "qcom,lahainap", "qcom,mtp";
	qcom,msm-id = <415 0x20000>, <456 0x20000>, <501 0x20000>;
        qcom,board-id = <0x10008 0>;
};
