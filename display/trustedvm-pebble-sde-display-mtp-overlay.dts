// SPDX-License-Identifier: BSD-3-Clause
/*
 * Copyright (c) Qualcomm Technologies, Inc. and/or its subsidiaries.
 */
/dts-v1/;
/plugin/;

#include "trustedvm-pebble-sde.dtsi"
#include "trustedvm-pebble-sde-display-mtp.dtsi"

/ {
	model = "Qualcomm Technologies, Inc. Pebble SVM MTP";
	compatible = "qcom,pebble-mtp", "qcom,pebble", "qcom,mtp";
	qcom,board-id = <8 0>;
};
