/dts-v1/;
/plugin/;

#include "yupik-sde-display-idp-pm7250b.dtsi"

/ {
	model = "Qualcomm Technologies, Inc. YupikP IOT IDP + PM7250B";
	compatible = "qcom,yupikp-iot-idp", "qcom,yupikp-iot", "qcom,idp";
	qcom,msm-id = <498 0x10000>, <575 0x10000>,<576 0x10000>;
	qcom,board-id = <34 0>;
	qcom,pmic-id = <0x0 0x0 0x0 0x0 0x0 0x0 0x0 0x0 0x2e>;
	qcom,pmic-id-size = <9>;
};
