// SPDX-License-Identifier: BSD-3-Clause
/*
 * Copyright (c) Qualcomm Technologies, Inc. and/or its subsidiaries.
 */

/dts-v1/;
/plugin/;

#include "lahaina-sde-display-qrd.dtsi"

/ {
	model = "Qualcomm Technologies, Inc. Lahaina QRD";
	compatible = "qcom,lahaina-qrd", "qcom,lahaina", "qcom,qrd";
	qcom,msm-id = <415 0x10000>;
	qcom,board-id = <0x1000B 0>;

};
