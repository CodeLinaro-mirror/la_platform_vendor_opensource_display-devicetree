// SPDX-License-Identifier: BSD-3-Clause
/*
 * Copyright (c) Qualcomm Technologies, Inc. and/or its subsidiaries.
 */

/dts-v1/;
/plugin/;

#include "diwali-sde-display-atp.dtsi"

/ {
	model = "Qualcomm Technologies, Inc. Diwali IDP AMOLED";
	compatible = "qcom,diwali-idp", "qcom,diwali", "qcom,idp";
	qcom,msm-id = <506 0x10000>;
	qcom,board-id = <34 3>;
};
